## software/buildroot/config_raspberrypi0w/Config.in
```kconfig
source "$BR2_EXTERNAL_ZEROROOT_PATH/package/gphoto2/Config.in"
source "$BR2_EXTERNAL_ZEROROOT_PATH/package/python-exifread/Config.in"
source "$BR2_EXTERNAL_ZEROROOT_PATH/package/python-hid/Config.in"
source "$BR2_EXTERNAL_ZEROROOT_PATH/package/python-plumbum/Config.in"
source "$BR2_EXTERNAL_ZEROROOT_PATH/package/python-rpyc/Config.in"
source "$BR2_EXTERNAL_ZEROROOT_PATH/package/python-smbus2/Config.in"
```

## software/buildroot/config_raspberrypi0w/configs/zeroroot_defconfig
```kconfig
# configs/raspberrypi0w_defconfig:

BR2_arm=y
BR2_arm1176jzf_s=y
BR2_ARM_EABIHF=y

# Linux headers same as kernel, a 5.4 series
BR2_PACKAGE_HOST_LINUX_HEADERS_CUSTOM_5_4=y

BR2_TOOLCHAIN_BUILDROOT_CXX=y

BR2_TARGET_GENERIC_HOSTNAME="compressorcam"
BR2_TARGET_GENERIC_ISSUE="--- CompressorCam ---"

BR2_LINUX_KERNEL=y
BR2_LINUX_KERNEL_CUSTOM_TARBALL=y
BR2_LINUX_KERNEL_CUSTOM_TARBALL_LOCATION="$(call github,raspberrypi,linux,ff93994fb3f92070d8521d709ad04675ecaa5817)/linux-ff93994fb3f92070d8521d709ad04675ecaa5817.tar.gz"
BR2_LINUX_KERNEL_DEFCONFIG="bcmrpi"
BR2_LINUX_KERNEL_DTS_SUPPORT=y
BR2_LINUX_KERNEL_NEEDS_HOST_OPENSSL=y
BR2_LINUX_KERNEL_INTREE_DTS_NAME="bcm2708-rpi-zero-w"

BR2_PACKAGE_RPI_FIRMWARE=y
BR2_PACKAGE_RPI_FIRMWARE_X=y
BR2_PACKAGE_RPI_WIFI_FIRMWARE=y

# Required tools to create the SD image
BR2_PACKAGE_HOST_DOSFSTOOLS=y
BR2_PACKAGE_HOST_GENIMAGE=y
BR2_PACKAGE_HOST_MTOOLS=y

# Filesystem / image
BR2_TARGET_ROOTFS_EXT2=y
BR2_TARGET_ROOTFS_EXT2_4=y
BR2_TARGET_ROOTFS_EXT2_SIZE="120M"
# BR2_TARGET_ROOTFS_TAR is not set
BR2_ROOTFS_POST_BUILD_SCRIPT="$(BR2_EXTERNAL_ZEROROOT_PATH)/board/raspberrypi0w/post-build.sh"
BR2_ROOTFS_POST_IMAGE_SCRIPT="$(BR2_EXTERNAL_ZEROROOT_PATH)/board/raspberrypi0w/post-image.sh"

BR2_ROOTFS_POST_SCRIPT_ARGS="--add-miniuart-bt-overlay"

### own settings:

BR2_CCACHE=y
BR2_TOOLCHAIN_BUILDROOT_GLIBC=y
BR2_ROOTFS_DEVICE_CREATION_DYNAMIC_EUDEV=y
BR2_TARGET_GENERIC_ROOT_PASSWD="root"
BR2_SYSTEM_DHCP="eth0"
BR2_ROOTFS_USERS_TABLES="$(BR2_EXTERNAL_ZEROROOT_PATH)/userfile"
BR2_ROOTFS_OVERLAY="$(BR2_EXTERNAL_ZEROROOT_PATH)/overlay/"

BR2_TARGET_ROOTFS_EXT2_SIZE="250M"

BR2_PACKAGE_DOSFSTOOLS=y
BR2_PACKAGE_DOSFSTOOLS_FATLABEL=y
BR2_PACKAGE_DOSFSTOOLS_FSCK_FAT=y
BR2_PACKAGE_DOSFSTOOLS_MKFS_FAT=y
BR2_PACKAGE_E2FSPROGS_RESIZE2FS=y
BR2_PACKAGE_E2TOOLS=y
BR2_PACKAGE_EXFAT=y
BR2_PACKAGE_EXFAT_UTILS=y
BR2_PACKAGE_EXFATPROGS=y

BR2_PACKAGE_PARTED=y
BR2_PACKAGE_RPI_USERLAND=y
BR2_PACKAGE_UHUBCTL=y

BR2_PACKAGE_PYTHON3=y
BR2_PACKAGE_PYTHON3_CURSES=y
BR2_PACKAGE_PYTHON3_READLINE=y
BR2_PACKAGE_PYTHON_FLASK=y
BR2_PACKAGE_PYTHON_NUMPY=y
BR2_PACKAGE_PYTHON_PILLOW=y
BR2_PACKAGE_PYTHON_PIP=y
BR2_PACKAGE_PYTHON_PSUTIL=y
BR2_PACKAGE_PYTHON_PYGAME=y
BR2_PACKAGE_PYTHON_PYUSB=y
BR2_PACKAGE_PYTHON_PYYAML=y
BR2_PACKAGE_PYTHON_REQUESTS=y
BR2_PACKAGE_PYTHON_RPI_GPIO=y
BR2_PACKAGE_PYTHON_SERIAL=y
BR2_PACKAGE_PYTHON_SPIDEV=y
BR2_PACKAGE_PYTHON_GUNICORN=y

BR2_PACKAGE_FREETYPE=y # required for fonts in pillow
BR2_PACKAGE_TIFF=y     # required for tiff in pillow (and jpeg)
BR2_PACKAGE_HIDAPI=y
BR2_PACKAGE_LIBHID=y
BR2_PACKAGE_RNG_TOOLS=y 
BR2_PACKAGE_DNSMASQ=y
BR2_PACKAGE_DROPBEAR=y
BR2_PACKAGE_HOSTAPD=y  # not actually in use
BR2_PACKAGE_IW=y
BR2_PACKAGE_MJPG_STREAMER=y
BR2_PACKAGE_RSYNC=y
BR2_PACKAGE_UHTTPD=y   # not actually in use
BR2_PACKAGE_PICOCOM=y
BR2_PACKAGE_WPA_SUPPLICANT=y
BR2_PACKAGE_WPA_SUPPLICANT_AP_SUPPORT=y
BR2_PACKAGE_WPA_SUPPLICANT_CLI=y
BR2_PACKAGE_ZSH=y
BR2_PACKAGE_NANO=y
BR2_PACKAGE_LIBRAW=y
BR2_PACKAGE_LIBRSVG=y
BR2_PACKAGE_OPENCV3=y
BR2_PACKAGE_OPENCV3_LIB_IMGCODECS=y
BR2_PACKAGE_OPENCV3_LIB_PYTHON=y
BR2_PACKAGE_OPENCV3_WITH_JPEG=y

BR2_PACKAGE_GPHOTO2=y
BR2_PACKAGE_PYTHON_EXIFREAD=y
BR2_PACKAGE_PYTHON_HID=y
BR2_PACKAGE_PYTHON_RPYC=y
BR2_PACKAGE_PYTHON_SMBUS2=y
BR2_PACKAGE_PYTHON_PICAMERA=y
```

## software/buildroot/config_raspberrypi0w/package/gphoto2/Config.in
```kconfig
config BR2_PACKAGE_GPHOTO2
	bool "gphoto2"
	select BR2_PACKAGE_POPT
	select BR2_PACKAGE_LIBGPHOTO2
        help
          gPhoto2 is a free, redistributable, ready to use set of digital 
          camera software applications for Unix-like systems, written by 
          a whole team of dedicated volunteers around the world. 
          It supports more than 2500 cameras.

          http://www.gphoto.org/
```

## software/buildroot/config_raspberrypi0w/package/python-exifread/Config.in
```kconfig
config BR2_PACKAGE_PYTHON_EXIFREAD
	bool "python-exifread"
	help
	  Read Exif metadata from tiff and jpeg files.

	  https://github.com/ianare/exif-py
```

## software/buildroot/config_raspberrypi0w/package/python-hid/Config.in
```kconfig
config BR2_PACKAGE_PYTHON_HID
	bool "python-hid"
	help
	  ctypes bindings for hidapi.

	  https://github.com/apmorton/pyhidapi
```

## software/buildroot/config_raspberrypi0w/package/python-picamera/Config.in
```kconfig
config BR2_PACKAGE_PYTHON_PICAMERA
	bool "python-picamera"
	help
	  A pure Python interface for the Raspberry Pi camera module.

	  http://picamera.readthedocs.io/
```

## software/buildroot/config_raspberrypi0w/package/python-plumbum/Config.in
```kconfig
config BR2_PACKAGE_PYTHON_PLUMBUM
	bool "python-plumbum"
	help
	  Plumbum: shell combinators library.

	  https://plumbum.readthedocs.io
```

## software/buildroot/config_raspberrypi0w/package/python-rpyc/Config.in
```kconfig
config BR2_PACKAGE_PYTHON_RPYC
	bool "python-rpyc"
	select BR2_PACKAGE_PYTHON_PLUMBUM # runtime
	help
	  Remote Python Call (RPyC), a transparent and symmetric RPC
	  library.

	  http://rpyc.readthedocs.org
```
